//
// Sample sketch to demo the ssd1327 library on a 256x64x4-bpp
// SSD1322 display. The library currently supports 2 display types:
// SSD1322 (256x64x4-bpp) and SSD1327 (128x128x4-bpp)
// For my testing, I connected the display to a Lolin D32
// ESP32 board and used the following pins to communicate
// with the display. Change these to fit your setup
//
#define DC_PIN 12
#define CS_PIN 5
#define RESET_PIN 13

#include <ssd1327.h>

// 40x40 pattern bitmap
// Classic Mac bomb icon
// This is a 1-bpp image that will be drawn using
// the ssd1327DrawPattern() function. This function
// draws a transparent pattern in any 'color'. Each 1 bit
// will be drawn in the given color and 0 bits will be transparent
//
uint8_t ucBombMask[] = {0x00,0x00,0x00,0x00,0x00,0x00,0x00,0x00,0x00,0x00,0x00,0x00,0x00,0x00,
  0x00,0x00,0x00,0x00,0x00,0x00,0x00,0x00,0x00,0x00,0x00,0x00,0x00,0x00,0x00,0x00,
  0x00,0x00,0x00,0x00,0x00,0x00,0x80,0x00,0x00,0x00,0x00,0x00,0x04,0x21,0x00,0x00,
  0x00,0x00,0x00,0x00,0x01,0x02,0x00,0x00,0x00,0x00,0x00,0x00,0x00,0x50,0x00,0x00,
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  0x00,0x00};

void ShowGraphic(int iAngle)
{
uint8_t u8Temp[8*40]; // holds the rotated mask
char szTemp[32];

   ssd1327Fill(0);
   sprintf(szTemp,"Angle = %d  ", iAngle); // show current angle
   ssd1327WriteString(80,0,szTemp,FONT_NORMAL, 15,0);
   // Rotate the source bitmap to the given angle and store
   // in a temporary buffer
   ssd1327RotateBitmap(ucBombMask, u8Temp, 1, 40, 40, 8, 20, 20, iAngle);
   // Draw the rotated bitmap (1-bpp) as a transparent pattern
   ssd1327DrawPattern(u8Temp, 8, 106, 6,40,40,7);
   // Show the backbuffer (write it) to the physical display
   ssd1327ShowBitmap(NULL,0, 0,0,256,64);

} /* ShowGraphic() */

void setup() {
  Serial.begin(115200);
// void ssd1327SPIInit(int iType, int iDC, int iCS, int iReset, int bFlip, int bInvert, int32_t iSpeed);  
  ssd1327SPIInit(OLED_256x64, DC_PIN, CS_PIN, RESET_PIN, 1, 0, 36000000);
} // setup

void loop() {
int i, j, iCount;
uint8_t dt, clk, prev;
int iAngle = 0;

// Rotate a small bitmap
  for (iCount=0; iCount<100; iCount++)
  {
    iAngle += 4;
    if (iAngle >= 360) iAngle -= 360;
    else if (iAngle < 0) iAngle += 360;
    ShowGraphic(iAngle);
    delay(50);
  }
// Bounce some transparent text on top of a background
// of lines and an ellipse
  for (iCount=0; iCount<5; iCount++)
  {
    for (j=0; j<48; j++) // Y position
    {
      ssd1327Fill(0);
      for (i=0; i<256; i+=4)
         ssd1327DrawLine(i,0,255-i,63,7);
      for (i=0; i<64; i+=4)
         ssd1327DrawLine(255,i,0,63-i,7);
      ssd1327Ellipse(128,32,20,20,15, 0);
      ssd1327WriteString(0,j,"SSD1327/SSD1322", FONT_LARGE,15,-1);
      ssd1327ShowBitmap(NULL,0, 0,0,256,64);
      delay(20);
    }
    for (j=48; j>=0; j--) // Y position
    {
      ssd1327Fill(0);
      for (i=0; i<256; i+=4)
         ssd1327DrawLine(i,0,255-i,63,7);
      for (i=0; i<64; i+=4)
         ssd1327DrawLine(255,i,0,63-i,7);
      ssd1327Ellipse(128,32,20,20,15, 0);
      ssd1327WriteString(0,j,"SSD1327/SSD1322", FONT_LARGE,15,-1);
      ssd1327ShowBitmap(NULL,0, 0,0,256,64);
      delay(20);
    }
  }

} // loop
